## config/west.yml
```yaml
manifest:
  remotes:
    - name: zmkfirmware
      url-base: https://github.com/zmkfirmware
    - name: self
      url-base: https://github.com/Galakutar/ZMK-protov1

  projects:
    - name: zmk
      remote: zmkfirmware
      revision: main
      path: zmk
    - name: config
      remote: self
      path: config

  self:
    path: app
```
